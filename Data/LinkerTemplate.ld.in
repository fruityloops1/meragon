SECTIONS
{
    . = CODE_OFFSET ;
    __code_offset__ = CODE_OFFSET ;
    __main_offset__ = 0x00100000;
    .hk : {
        ASSERT(. == CODE_OFFSET, "wrong code offset");
        *(.hk.header)
        *(.hk.init)
        KEEP (*(.hk.initend))
    }
    .hk.hooks : {
        *(.hk.hooks)
    }
    .text : {
        __text_start = . ;
        *(.text)
        *(.text.*)
		KEEP (*(.text.exported))
        __rodata_start = . ;
        *(.rodata)
        __rodata_end = . ;
        *(.data)
        *(.bss)
        *(COMMON)
        __text_end  = . ;
		__end__ = __text_end;
    }
    .ARM : {
        *(.ARM.exidx)
    }
}